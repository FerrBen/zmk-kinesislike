## boards/shields/dactyl/Kconfig.defconfig
```kconfig
if SHIELD_DACTYL_LEFT

config ZMK_KEYBOARD_NAME
    default "Dactyl Manuform"

config ZMK_SPLIT_ROLE_CENTRAL
    bool
    default y

endif

if SHIELD_DACTYL_RIGHT

config ZMK_SPLIT_ROLE_PERIPHERAL
    bool
    default y

config EC11
    default y

config EC11_TRIGGER_GLOBAL_THREAD
    default y

endif

if SHIELD_DACTYL_LEFT || SHIELD_DACTYL_RIGHT

config ZMK_SPLIT
    bool
    default y

endif
```
